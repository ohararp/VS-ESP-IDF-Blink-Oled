## main/Kconfig.projbuild
```kconfig
menu "Example Configuration"

    orsource "$IDF_PATH/examples/common_components/env_caps/$IDF_TARGET/Kconfig.env_caps"

    choice BLINK_LED
        prompt "Blink LED type"
        default BLINK_LED_GPIO
        help
            Select the LED type. A normal level controlled LED or an addressable LED strip.
            The default selection is based on the Espressif DevKit boards.
            You can change the default selection according to your board.

        config BLINK_LED_GPIO
            bool "GPIO"
        config BLINK_LED_STRIP
            bool "LED strip"
    endchoice

    choice BLINK_LED_STRIP_BACKEND
        depends on BLINK_LED_STRIP
        prompt "LED strip backend peripheral"
        default BLINK_LED_STRIP_BACKEND_RMT if SOC_RMT_SUPPORTED
        default BLINK_LED_STRIP_BACKEND_SPI
        help
            Select the backend peripheral to drive the LED strip.

        config BLINK_LED_STRIP_BACKEND_RMT
            depends on SOC_RMT_SUPPORTED
            bool "RMT"
        config BLINK_LED_STRIP_BACKEND_SPI
            bool "SPI"
    endchoice

    config BLINK_GPIO
        int "Blink GPIO number"
        range ENV_GPIO_RANGE_MIN ENV_GPIO_OUT_RANGE_MAX
        default 8
        help
            GPIO number (IOxx) to blink on and off the LED.
            Some GPIOs are used for other purposes (flash connections, etc.) and cannot be used to blink.

    config BLINK_PERIOD
        int "Blink period in ms"
        range 10 3600000
        default 1000
        help
            Define the blinking period in milliseconds.

    config OLED_I2C_SDA
        int "OLED I2C SDA GPIO"
        default 8
        help
            GPIO number for I2C SDA to the SSD1306 OLED display.

    config OLED_I2C_SCL
        int "OLED I2C SCL GPIO"
        default 9
        help
            GPIO number for I2C SCL to the SSD1306 OLED display.

    menu "OTA Update Configuration"

        config OTA_WIFI_SSID
            string "WiFi SSID for OTA"
            default "MYSSID"
            help
                WiFi network name used when connecting for OTA updates.

        config OTA_WIFI_PASSWORD
            string "WiFi Password for OTA"
            default "MYPASSWORD"
            help
                WiFi password used when connecting for OTA updates.

        config OTA_FIRMWARE_URL
            string "OTA Firmware URL"
            default "https://github.com/ohararp/VS-ESP-IDF-Blink-Oled/releases/latest/download/blink.bin"
            help
                URL to download the firmware binary for OTA update.

        config OTA_BUTTON_GPIO
            int "OTA trigger button GPIO"
            default 39
            help
                GPIO number for the button that triggers OTA update (active-low).

    endmenu

endmenu
```

## sdkconfig.defaults
```kconfig
CONFIG_BLINK_LED_STRIP=y
CONFIG_BLINK_GPIO=48
CONFIG_ESPTOOLPY_FLASHSIZE_16MB=y
CONFIG_ESPTOOLPY_FLASHSIZE="16MB"
CONFIG_PARTITION_TABLE_TWO_OTA=y
```
